## qt6-calculator-rpi3/package/iti-gpio/Config.in
```kconfig
config BR2_PACKAGE_ITI_GPIO
    bool "iti-gpio"
    depends on BR2_PACKAGE_QT6BASE
    depends on BR2_PACKAGE_QT6BASE_GUI
    depends on BR2_PACKAGE_QT6DECLARATIVE
    select BR2_PACKAGE_QT6SHADERTOOLS
    help
      Simple calculator Qt6 QML app for Raspberry Pi 3B+
```
